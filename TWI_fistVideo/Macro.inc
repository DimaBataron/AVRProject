
; * Macro.inc
; *
; *  Created: 21.02.2021 17:41:12
; *   Author: dima
;R18 и R19 рабочие регистры
;
;Макросы: 
;	-Перевода бита в противоположное состояние
;	-ВВОД\вывод из РОН в РВВ и наоборот					+
;	-конфигурации битов порта ввода ввыаода в новое состояние с сохранением старого+
;	-Конфигурация SPI на передачу, прием				+
;	-Передача по SPI 16 bit								+
;	-Частота работы TWI	(Частота тактового сигнала)		+
;   -Перевод ноги в противоположное состояние по таймеру +
;	-Запуск таймера на прерывания						+
.include "F:/AVR/7.0/packs/atmel/ATmega_DFP/1.6.364/avrasm/inc/m328Pdef.inc"
;
;==================================================================
;ВВОД\вывод из РОН в РВВ и наоборот
;Пересылка из РОН @0 в регистр РВВ @1		-- @0=@1 -- (A=R1)
.MACRO DOUT
.IF @0<64
out      @0,@1 ;Пересылка из РОН @0 в регистр РВВ @1  
.ELSE
sts     @0,@1 ;Непосредственная запись в ОЗУ(MemoryMapped???)
.ENDIF
.ENDMACRO
;
;Пересылка из РВВ@1 в РОН@0  -@0=@1 -- (R1=A)
.MACRO DIN
.IF @1<64
in      @0,@1 
.ELSE
lds     @0,@1 ;Непосредтвенное чтение из ОЗУ
.ENDIF
.ENDMACRO
;
;
;========================================================================
;Макрос конфигурации бита порта в новое состояние с сохранением стаорого
;-Макрос сохраняет старое состояние порта
;-@0  ---Именование порта 
;-@1  ---Пишем бинарное значение DDRx - направление передачи --1 выход; 0 вход--
; Для перевода бита в новое состояние пишем 1 все остальные 0.
;-@2  ---Пишем бинарное значение PORTx - направление передачи 
; Для перевода бита в новое состояние пишем 1 все остальные 0.
;DDRx=0 и PORTx=1 состояние подтягивающего ключа ВКЛЮЧЕН(1 на выходе)
.MACRO DPORT
ldi r18,@1
DIN r19,DDR@0
eor r18,r19  ;исключающее-ИЛИ
DOUT DDR@0,r18
;
ldi r18,@2
DIN r19,PORT@0
eor r18,r19	 ;исключающее-ИЛИ
DOUT PORT@0,r18
.ENDMACRO
;
;ПРИМЕР:  DPORT D,0b0000110,0b0000110
;====================================================================
;	-Конфигурация SPI на передачу, прием.
;	-Передача по SPI 16 bit
;(Занимает много места, для начала пойдет)
;ВНИМАНИЕ!!!! ПРИ передачи по 16 бит вручную юзаем PB1 или другой. !!!!!!!!!!!
;
;@0 --Передача пакета 8бит или 16бит (Из PB1= D9 выход SS для 16бит)
;0 -- конфигурация на прием
;@1 --бит SPI2X в SPSR для умножения частоты передачи 
;@2 --число в SPCR для настройки передачи
;
;ПРИМЕР DSPI 16,0,0b11111001 
.MACRO DSPI
.if @0==8	;8 бит
		IN r18,DDRB ;получаем значение регистра 
		ldi r19,(1<<PB2)|(1<<PB3)|(1<<PB5)
		or r18,r19		;логическое или результат в r16
		out DDRB,r18	;Конфигурация регистра порта как выходного
.ENDIF
.if @0==16	;16 бит
		IN r18,DDRB ;получаем значение регистра 
		ldi r19,(1<<PB1)|(1<<PB3)|(1<<PB5)|(1<<PB2) ;Без PB2 неработает
		or r18,r19		;логическое или результат в r16
		out DDRB,r18	;Конфигурация регистра порта как выходного
.else
		IN r18,DDRB ;получаем значение регистра 
		ldi r19,(1<<PB0)|(1<<PB1)|(1<<PB4)|(1<<PB6)|(1<<PB7)
		and r18,r19		;логическое или результат в r16
		out DDRB,r18	;Конфигурация регистра порта как входного
.endif 
.if @1==0
ldi r18,0
DOUT SPSR,r18
.else
ldi r18,1
DOUT SPSR,r18
.ENDIF
ldi r18,@2
DOUT SPCR,r18
.ENDMACRO
;С SPI работают Атмега168 
;SCK	PB5 --> D13
;MISO	PB4 --> D12
;MOSI	PB3 --> D11
;SS		PB2 --> D10 (8bit)
;SS     PB1 --> D9	(16bit) Управляем вручную
;Конфигурируем SS, MОSI и SCK как выходные.
;
;SPIE	1 Разрешить прерывания от модуля 
;SPE	1 Разрешить работу модуля
;MSTR	1 Работать в режиме Master
;DORD	1 Первым передается младший бит
;CPOL   1 тактовые испульсы отрицетельные
;CPHA	0 по переднему фронту
;SPR1:SPR0   01  clk/16 делим системную частоту на 16
;SPI2X:SPR1:SPR0
;0		0		0	fclc/4
;0		0		1	fclc/16
;0		1		0	fclc/64
;0		1		1	fclc/128
;1		0		0	fclc/2
;1		0		1	fclc/8
;1		1		0	fclc/32
;1		1		1	fclc/64
;==========================================================================
;РАБОТАЕТ пример и можно в макросах использовать макрос
.MACRO DP
ldi r18, 0b00000001
DOUT PORT@0, r18
ldi r18,(1<<PUD)
DOUT MCUCR, r18
.ENDMACRO
;
;=================================================================
;Макрос кофигурации скорости передачи TWI
;r18,r19 мусорные
;Пример TWFscl 0,0 
; Что соответствует 1Мгц
;   @0-максимальное значение 256 @1- максимальное значение 3  
.MACRO TWFscl 
ldi r18,@0
DOUT TWBR,r18
ldi r18,@1
DIN r19,TWSR
eor r18,r19  ;исключающее-ИЛИ
DOUT TWSR,r18  ;Переводим биты где 1 в противоположное состояние
.ENDMACRO
;====================================================================
 ;Обработчик прерывания по переполнению таймера мигающий диодом. 
 ;r23-используется,r18-мусорная r17-мусорная
 ;Сюда переходим по прерыванию
 ;@0-регистр содержащий количество прерываний сделанных уже
 ;@1-регистр задержки таймера 
 ;@2-количество раз которые необходимо мигнуть
 ;@3-таймер по которому делаем прерывание  (0)
 ;@4-Буква порта пином которого мигаем (B)
 ;@5-Сдвиг бита в порте которым мигаем (0)
 ;ПРИМЕР DBLINK r20,r21,r22,0,B,0
.MACRO DBLINK
		   inc @0    ;при прерывании увеличиваем значение счетчика
		   cp @0,@1 ; сравниваем счетчик и значение задержки таймера
		   breq blink ; переход по "равно"
		   reti
;Выдержали указанную задержку и ниже перешли спустя выставленное время
Blink:	   ldi @0,0   ;записать в @0=0 по сопадению
		   cp @2,r23		  ; сравниваем количетво миганий
		   brne Blink_num     ; не равно
;		   
		   ;Отключаем мигания если мигнули нужное количество
		   ldi r18,0		  ; сюда если равно.Запрещаем прерывания таймера
		   sts TIMSK@3,r18	  ; TOIE0=0 запрещение прерываний по переполнению счетчика 
		   ldi r23,0		  ; Обнуляем счетчик количества миганий
;==============================================================
		   ;здесь код для конкретной задачи, можно удалять
			cpi r21,0 ;сколько уже мигнули
			BREQ Kon ;если равны переход
			rjmp Mig
;=======================================================
Kon:   	    reti				  ; НЕ ЗАБЫТЬ ВКЛЮЧИТЬ ПРИ ПРИНЯТИИ БАЙТА ПО SPI
;		   
		   ;Еще не мигнули нужное количество раз			  
Blink_num: IN r18,PORT@4 ;загрузим в r18 значение
		   ldi r17,(1<<P@4@5) ;(Переписал на PB0)
		   EOR r18,r17 ;исключающее или 2х рон результат в r16
		   OUT PORT@4,r18; включаем или отключаем диод
		   ;после этой команды DDRB=1 PORTB=0 или 1
		   ;DDRB=1 значит выход сконфигурирован как выходной
		   ;тогда PORTB определяет логический уровень (Низкий 0)	
		   andi r18,(1<<P@4@5) ; логическое и РОН и константы??
		   cp r18,@0		 ;сравниваем с нулём значение PB5
		   breq Count        ;равно. PB5 =0
		   reti
Count:	   inc r23   ; считаем мигание если в BP5 = 1 тогда inc r23
		   reti
.ENDMACRO
;=============================================================================
;Процедура конфигурации таймера на прерывания по переполнения счетчика таймера
;Внимание при использовании этой процедуры старые настройки обнуляются,
;необходимо переписывать под свою задачу
;ПРИМЕР: DCONFTIME 0,5  второе число делитель на 1024
.MACRO DCONFTIME 
			sei ;установка флага I SREG(глобальное разрешение прерываний)	
			ldi r30,1
			sts TIMSK@0,r30			
			ldi r30,@1
		    out TCCR@0B,r30 ;установка делителя на 1024
.ENDMACRO
;С делителем на 1024 переполнение происходит ((16*10^6)/1024)/256= 61.03 раз в секунду
;
;===================================================================
